## components/gui/Kconfig
```kconfig
menu "SPECTRA GUI"

config SPECTRA_GUI_ENABLE
    bool "Enable GUI foundation task and event queue"
    default y
    help
        Enables the GUI foundation module, including event queue and
        main GUI task skeleton.

config SPECTRA_GUI_ENABLE_HW_DRIVERS
    bool "Enable TFT/touch hardware driver access"
    depends on SPECTRA_GUI_ENABLE
    default y
    help
        Enables direct hardware calls for TFT and touch drivers.
        Disable this in headless labs without display/touch hardware.

endmenu
```

## components/storage/Kconfig
```kconfig
menu "SPECTRA Storage"

config SPECTRA_STORAGE_ENABLE_SD
    bool "Enable SD card mount and file operations"
    default y
    help
        Enables SDSPI-based SD card support in storage manager.
        If target SoC does not expose GPSPI support in current IDF profile,
        runtime will gracefully fall back to not-supported mode.

endmenu
```

## sdkconfig.defaults
```kconfig
# SPECTRA baseline for ESP32-C5 bootstrap (phase 1.1)
CONFIG_IDF_TARGET="esp32c5"

# Core RTOS/system behavior
CONFIG_FREERTOS_HZ=1000
CONFIG_ESP_TASK_WDT_TIMEOUT_S=30
CONFIG_ESP_MAIN_TASK_STACK_SIZE=6144

# Partition table
CONFIG_PARTITION_TABLE_CUSTOM=y
CONFIG_PARTITION_TABLE_FILENAME="partitions.csv"
CONFIG_ESPTOOLPY_FLASHSIZE_4MB=y

# Radio stack baseline (enabled, passive capabilities only in Sprint 0)
CONFIG_ESP_WIFI_ENABLED=y
CONFIG_BT_ENABLED=y
CONFIG_BT_NIMBLE_ENABLED=y
CONFIG_IEEE802154_ENABLED=y
CONFIG_ESP_WIFI_SOFTAP_SUPPORT=y
CONFIG_ESP_WIFI_NAN_ENABLE=n
CONFIG_LWIP_SO_RCVBUF=y
CONFIG_SPECTRA_STORAGE_ENABLE_SD=y

# PSRAM tuning will be enabled in board-specific profiles when symbols are available

# Logging baseline
CONFIG_LOG_DEFAULT_LEVEL_INFO=y
```
